## SourceCode/App/ICU/boards/arm/optimus_icu_nrf5340/Kconfig.board
```kconfig
# Optimus_ICU NRF5340 board configuration

# Copyright (c) 2019-2020 Nordic Semiconductor ASA
# SPDX-License-Identifier: Apache-2.0

if SOC_NRF5340_CPUAPP_QKAA

config BOARD_OPTIMUS_ICU_NRF5340_CPUAPP
	bool "NeuroXess Optimus ICU nRF5340 Application MCU"

config BOARD_OPTIMUS_ICU_NRF5340_CPUAPP_NS
	bool "NeuroXess Optimus ICU nRF5340 Application MCU non-secure"

endif # SOC_NRF5340_CPUAPP_QKAA

config BOARD_OPTIMUS_ICU_NRF5340_CPUNET
	bool "NeuroXess Optimus ICU NRF5340 Network MCU"
	depends on SOC_NRF5340_CPUNET_QKAA
```
